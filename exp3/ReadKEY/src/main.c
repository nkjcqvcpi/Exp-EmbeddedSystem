/****************************************Copyright (c)**************************************************
**                               Guangzhou ZHIYUAN electronics Co.,LTD.
**                                     
**                                 http://www.zyinside.com
**
**--------------File Info-------------------------------------------------------------------------------
** File Name: main.c
** Last modified Date: 2006-01-05
** Last Version: v1.0
** Description: MagicARM2410实验箱的基础实验---GPIO输入实验。
**              使用GPIO输入模式对GPF4口进行扫描，对蜂鸣器控制。
**------------------------------------------------------------------------------------------------------
** Created By: 黄绍斌
** Created date: 2006-01-05
** Version: v1.0
** Descriptions:
**
**------------------------------------------------------------------------------------------------------
** Modified by:
** Modified date:
** Version:
** Description:
**
********************************************************************************************************/
#include  "config.h"

// 定义独立按键KEY1的输入口
#define     KEY_CON		    (1<<4)          /* GPF4口  */

// 定义蜂鸣器控制口
#define   	BEEP		   	(1<<10)     	/* GPH10口 */	
#define   	BEEP_MASK	  	(~BEEP)


/*********************************************************************************************************
** Function name: DelayNS
** Descriptions: 长软件延时。
**              延时时间与系统时钟有关。
** Input: dly	延时参数，值越大，延时越久
** Output: 无
** Created by: 黄绍斌
** Created Date: 2005-12-31 
**-------------------------------------------------------------------------------------------------------
** Modified by:
** Modified Date: 
**------------------------------------------------------------------------------------------------------
********************************************************************************************************/
void  DelayNS(uint32  dly)
{  
	uint32  i;

   	for(; dly>0; dly--) 
       for(i=0; i<50000; i++);
}



/*********************************************************************************************************
** Function name: main
** Descriptions: 不断地读取GPF4口的值，并输出控制蜂鸣器B1。           
** Input: 无
** Output: 系统返回值0
** Created by: 黄绍斌
** Created Date: 2005-12-31 
**-------------------------------------------------------------------------------------------------------
** Modified by:
** Modified Date: 
**------------------------------------------------------------------------------------------------------
********************************************************************************************************/
int  main(void)
{	
    // 初始化I/O
    rGPFCON = (rGPFCON & (~(0x03<<8)));                 // rGPFCON[9:8] = 00b，设置GPF4为GPIO输入模式   
    rGPHCON = (rGPHCON & (~(0x03<<20))) | (0x01<<20);   // rGPHCON[21:20] = 01b，设置GPH10为GPIO输出模式 												
    
    while(1)
    {
        if(rGPFDAT & KEY_CON)   // 读取GPF口线上的电平，判断GPF4是否为高电平
        {
            rGPHDAT = rGPHDAT | BEEP;       // GPF4为高电平，则设置GPH10=1
        }
        else
        {
            rGPHDAT = rGPHDAT & BEEP_MASK;  // GPF4为低电平，则设置GPH10=0
        }
        
        DelayNS(1);
    }
    	
   	return(0);
}

/*********************************************************************************************************
**                            End Of File
********************************************************************************************************/
